## CMakeLists.txt
```
# SPDX-License-Identifier: Apache-2.0

cmake_minimum_required(VERSION 3.20.0)

find_package(Zephyr REQUIRED HINTS $ENV{ZEPHYR_BASE})
project(Central-Master-STM32)

target_sources(app PRIVATE
	src/main.c
	src/controller.c
	src/target.c
)
```

## Kconfig
```
# SPDX-License-Identifier: Apache-2.0

menu "SPI Uptime Exchange"

choice ROLE_SELECTION
	prompt "Node role"
	default ROLE_WORKER

config ROLE_WORKER
	bool "Worker (initiates SPI transfers)"

config ROLE_CHILD
	bool "Child (waits for worker clock)"

endchoice

endmenu

source "Kconfig.zephyr"
```

## prj.conf
```kconfig
CONFIG_SPI=y
CONFIG_SERIAL=y
CONFIG_CONSOLE=y
CONFIG_PRINTK=y
```

## controller.conf
```kconfig
CONFIG_ROLE_WORKER=y
```

## target.conf
```kconfig
CONFIG_ROLE_CHILD=y
```

## boards/app_target.overlay
```dts
&spi1 {
	status = "okay";
};
```

## src/main.c
```c
#include "benchmark_shared.h"

int main(void)
{
#if defined(CONFIG_ROLE_WORKER)
	return run_worker();
#elif defined(CONFIG_ROLE_CHILD)
	return run_child();
#else
#error "Either CONFIG_ROLE_WORKER or CONFIG_ROLE_CHILD must be selected"
#endif
}
```

## src/benchmark_shared.h
```c
#ifndef BENCHMARK_SHARED_H_
#define BENCHMARK_SHARED_H_

#include <stdint.h>

#include <zephyr/devicetree.h>
#include <zephyr/kernel.h>

#define SPI_DEV_NODE DT_NODELABEL(spi1)

#if !DT_NODE_HAS_STATUS(SPI_DEV_NODE, okay)
#error "spi1 must be enabled for this sample"
#endif

#define SPI_BASE_OPERATION (SPI_WORD_SET(8) | SPI_TRANSFER_MSB)

static inline void encode_u64_be(uint64_t value, uint8_t out[8])
{
	for (int i = 0; i < 8; i++) {
		out[i] = (uint8_t)((value >> (56 - (8 * i))) & 0xFFU);
	}
}

static inline void encode_worker_timestamp(uint64_t worker_ts, uint8_t tx[8])
{
	for (int i = 0; i < 8; i++) {
		/* TX_i = ((T_worker >> (56 - 8i)) & 0xFF) */
		tx[i] = (uint8_t)((worker_ts >> (56 - (8 * i))) & 0xFFU);
	}
}

static inline uint64_t decode_worker_timestamp(const uint8_t rx_data[8])
{
	uint64_t worker_ts = 0;

	for (int i = 0; i < 8; i++) {
		worker_ts = (worker_ts << 8) | rx_data[i];
	}

	return worker_ts;
}

int run_worker(void);
int run_child(void);

#endif /* BENCHMARK_SHARED_H_ */
```

## src/controller.c
```c
#include "benchmark_shared.h"

#include <errno.h>

#include <zephyr/drivers/spi.h>
#include <zephyr/sys/printk.h>

#define WORKER_SPI_OPERATION (SPI_BASE_OPERATION | SPI_OP_MODE_MASTER)

static const struct device *const spi_dev = DEVICE_DT_GET(SPI_DEV_NODE);
static const struct spi_config spi_cfg = {
	.operation = WORKER_SPI_OPERATION,
	.frequency = 1000000,
	.slave = 0,
};

int run_worker(void)
{
	if (!device_is_ready(spi_dev)) {
		printk("worker: SPI bus is not ready\n");
		return -ENODEV;
	}

	printk("worker: sending uptime timestamp every 1000 ms\n");

	while (1) {
		uint64_t worker_ts = (uint64_t)k_uptime_get();
		uint8_t tx_data[8];
		uint8_t rx_data[8] = {0};
		struct spi_buf tx_buf = {
			.buf = tx_data,
			.len = sizeof(tx_data),
		};
		struct spi_buf_set tx_set = {
			.buffers = &tx_buf,
			.count = 1,
		};
		struct spi_buf rx_buf = {
			.buf = rx_data,
			.len = sizeof(rx_data),
		};
		struct spi_buf_set rx_set = {
			.buffers = &rx_buf,
			.count = 1,
		};

		encode_worker_timestamp(worker_ts, tx_data);

		int ret = spi_transceive(spi_dev, &spi_cfg, &tx_set, &rx_set);
		if (ret < 0) {
			printk("worker: spi_transceive failed (%d)\n", ret);
			k_msleep(250);
			continue;
		}

		uint64_t child_ts = decode_worker_timestamp(rx_data);
		printk("worker: tx uptime=%llu ms, child reply=%llu ms\n",
		       (unsigned long long)worker_ts,
		       (unsigned long long)child_ts);
		k_msleep(1000);
	}

	return 0;
}
```

## src/target.c
```c
#include "benchmark_shared.h"

#include <errno.h>

#include <zephyr/drivers/spi.h>
#include <zephyr/sys/printk.h>

#define CHILD_SPI_OPERATION (SPI_BASE_OPERATION | SPI_OP_MODE_SLAVE)

static const struct device *const spi_dev = DEVICE_DT_GET(SPI_DEV_NODE);
static const struct spi_config spi_cfg = {
	.operation = CHILD_SPI_OPERATION,
	.frequency = 1000000,
	.slave = 0,
};

int run_child(void)
{
	if (!device_is_ready(spi_dev)) {
		printk("child: SPI bus is not ready\n");
		return -ENODEV;
	}

	printk("child: waiting for worker transfers\n");

	while (1) {
		uint8_t rx_data[8] = {0};
		struct spi_buf rx_buf = {
			.buf = rx_data,
			.len = sizeof(rx_data),
		};
		struct spi_buf_set rx_set = {
			.buffers = &rx_buf,
			.count = 1,
		};

		int ret = spi_transceive(spi_dev, &spi_cfg, NULL, &rx_set);
		if (ret < 0) {
			printk("child: spi_transfer failed (%d)\n", ret);
			k_msleep(100);
			continue;
		}

		uint64_t worker_ts = decode_worker_timestamp(rx_data);
		printk("child: rx worker uptime=%llu ms\n",
		       (unsigned long long)worker_ts);
	}

	return 0;
}
```
